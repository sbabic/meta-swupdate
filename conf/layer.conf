## conf/layer.conf
```bitbake
# We have a conf and classes directory, add to BBPATH
BBPATH .= ":${LAYERDIR}"

# We have a recipes directory, add to BBFILES
BBFILES += "${LAYERDIR}/recipes-*/*/*.bb \
	${LAYERDIR}/recipes-*/*/*.bbappend"

BBFILE_COLLECTIONS += "swupdate"
BBFILE_PATTERN_swupdate := "^${LAYERDIR}/"
BBFILE_PRIORITY_swupdate = "6"

LAYERSERIES_COMPAT_swupdate = "dunfell gatesgarth hardknott"

LAYERDEPENDS_swupdate = "openembedded-layer"
```
